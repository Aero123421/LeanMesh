## components/leanmesh/Kconfig
```kconfig
menu "LeanMesh"

    choice LEANMESH_PROFILE
        prompt "Capacity profile (config/profiles.json)"
        default LEANMESH_PROFILE_LEAF
        help
            Maximum role this image can run. The profile sizes fixed pools only; security,
            join and frame interpretation are identical for every profile (docs/16).
            Root-only code (topology, ledger, serial bridge) is compiled only for ROOT.

        config LEANMESH_PROFILE_LEAF
            bool "leaf"
        config LEANMESH_PROFILE_RELAY
            bool "relay"
        config LEANMESH_PROFILE_ROOT
            bool "root"
    endchoice

    config LEANMESH_OTA
        bool "Optional OTA: signed manifest check and rollback state (software part)"
        default n
        help
            Compiles the manifest verification, the persistent rollback state and the IDF ota hooks
            (docs/13 section 6). Off (default): none of that is linked, no buffer exists and the
            capability report says "not built". On does NOT enable OTA: there is no image transfer or
            writer in this release, so nothing runs the hooks. Needs the 4 MiB two-slot layout
            (config/partitions_4m.csv); on a layout without a second app slot the check answers
            UNSUPPORTED. Real power-cut and rollback evidence (O01, O03) needs hardware.

    config LEANMESH_ALLOW_PLAINTEXT_SECRETS
        bool "Development only: store the device key without NVS encryption"
        depends on !NVS_ENCRYPTION
        default n
        help
            The identity record holds the device's P-256 private key and the discovery_scope record the
            DiscoveryScopeKey (docs/12 section 2: secret payloads need NVS encryption). NVS partitions are not
            covered by flash encryption, so without CONFIG_NVS_ENCRYPTION anyone who reads the flash reads the key.
            A build without NVS encryption does not compile unless this acknowledgement is set. Never for a product.
            With NVS encryption the SDK mounts its `identity` and `state` partitions with the keys of the registered
            NVS security scheme and never creates those keys (that is provisioning: an eFuse write or the nvs_keys
            partition, the product's key custody); a missing key fails closed.

    config LEANMESH_BENCH_PROVISIONING
        bool "Bench/HIL only: on-board key generation and record provisioning (leanmesh_bench.h)"
        default n
        help
            Links lmb_keygen / lmb_provision_leaf / lmb_provision_root for test boards: the device key is
            generated on the board and the fleet-signed objects are written with the SDK's record layer before
            lm_init (components/leanmesh/bench/leanmesh_bench.h). For firmware/hil_node. Never for a product:
            a product's provisioning is its own key-custody process (docs/21, Issue #3).

    config LEANMESH_OBJECT_TRANSFER
        bool "Optional 4096 B object transfer (lm_send_object)"
        default n
        help
            Compiles the 4 KiB object buffer (about 4.2 KB of RAM) and its reassembly slot
            (docs/09 section 6). Off: lm_send_object returns UNSUPPORTED and lm_config_t
            object_transfer_enabled=1 is refused. On: the application still has to enable it
            at lm_init.

    menu "RF profile (docs/03 section 3)"
        config LEANMESH_RF_DEPLOYMENT_APPROVED
            bool "RF profile has a recorded deployment approval"
            default n
            help
                lm_start refuses to bring the radio up (RF_PROFILE_UNAPPROVED) unless this is set
                by a product build that holds a compliance record for country, board, antenna
                and channel set. Setting the country code is not a compliance statement.

        config LEANMESH_RF_COUNTRY
            string "Country code (2 letters)"
            default "JP"

        config LEANMESH_RF_CHANNEL
            int "Initial channel (1..13)"
            range 1 13
            default 1

        config LEANMESH_RF_ALLOWED_CHANNELS_MASK
            hex "Allowed channels, bit c = channel c"
            default 0x3FFE

        config LEANMESH_RF_TX_POWER_QDBM
            int "Maximum TX power in quarter dBm (8..84)"
            range 8 84
            default 40
    endmenu

endmenu
```

## firmware/common/bench_console/Kconfig.projbuild
```kconfig
menu "HIL bench board"
    config HIL_XIAO_C6_RF_SWITCH
        bool "Seeed XIAO ESP32C6: enable the RF switch (GPIO3 low) and select the on-board antenna (GPIO14 low)"
        default n
        help
            The XIAO ESP32C6 routes its antenna through an RF switch powered by GPIO3 (low = on); GPIO14 selects
            the on-board ceramic antenna (low) or the U.FL connector (high). Without this the radio runs without
            its antenna path. Board overlay for bench builds only (docs/03 §5: board differences stay out of core).

    config HIL_XIAO_C6_EXTERNAL_ANTENNA
        bool "Use the U.FL connector instead of the on-board antenna (GPIO14 high)"
        depends on HIL_XIAO_C6_RF_SWITCH
        default n
endmenu
```

## firmware/field_node/main/Kconfig.projbuild
```kconfig
menu "Field node"
    config FIELD_HUB75
        bool "Display build: draw the display state on a 64x32 HUB75 panel (ESP32-S3 only, checked at configure time)"
        default n
        help
            The Seengreat RGB Matrix HUB75 S3 board (ESP32-S3-WROOM-1-N16R8) with a 64x32 FM6124 panel. Needs
            CONFIG_LEANMESH_PROFILE_RELAY (the display relays: mains powered). Pulls the panel library
            ESP32-HUB75-MatrixPanel-DMA (MIT) in as a managed component (main/idf_component.yml).

    config FIELD_HUB75_BRIGHTNESS
        int "Display build: panel brightness (1..255)"
        depends on FIELD_HUB75
        range 1 255
        default 96
        help
            Passed to setBrightness8 of the panel library. The panel is bright: a low value is plenty on a desk.

    config FIELD_TOF
        bool "Display-tof: VL53L1X on I2C1 GPIO43/44"
        depends on FIELD_HUB75
        default n
        help
            One display only has ToF. Long, 33ms budget, 40ms period, 8x8 ROI center199.
            Keys use PCA9557 I2C0 GPIO1/2: bit1 K1, bit2 K3, active low.
            Physical K2/K3 labels and reset/download wiring are HIL-unverified.

    choice FIELD_LED
        prompt "Status LED"
        default FIELD_LED_ACTIVE_LOW if IDF_TARGET_ESP32C6
        default FIELD_LED_NONE

        config FIELD_LED_NONE
            bool "none"
        config FIELD_LED_ACTIVE_LOW
            bool "plain GPIO, on = low"
        config FIELD_LED_ACTIVE_HIGH
            bool "plain GPIO, on = high"
    endchoice

    config FIELD_LED_GPIO
        int "Status LED GPIO"
        depends on !FIELD_LED_NONE
        default 15
        help
            15 is the user LED (active low) of the Seeed XIAO ESP32C6. Blinking: joining, on: reachable, off: not a
            member / lost.
endmenu
```
